## configs/usedbytes_gadget_defconfig
```kconfig
BR2_arm=y
BR2_arm1176jzf_s=y
BR2_KERNEL_MIRROR="https://www.kernel.org/pub"
BR2_GNU_MIRROR="http://ftp.gnu.org/pub/gnu"
# BR2_COMPILER_PARANOID_UNSAFE_PATH is not set
BR2_TOOLCHAIN_BUILDROOT_GLIBC=y
BR2_GLIBC_VERSION_2_23=y
BR2_BINUTILS_VERSION_2_24_X=y
BR2_GCC_VERSION_5_X=y
BR2_TOOLCHAIN_BUILDROOT_CXX=y
BR2_TARGET_GENERIC_HOSTNAME="gadget"
BR2_TARGET_GENERIC_ISSUE="Welcome to Gadget"
BR2_INIT_SYSTEMD=y
BR2_TARGET_GENERIC_ROOT_PASSWD="root"
BR2_SYSTEM_BIN_SH_BASH=y
BR2_ROOTFS_OVERLAY="board/usedbytes/gadget/rootfs-overlay"
BR2_ROOTFS_POST_BUILD_SCRIPT="board/usedbytes/gadget/post-build.sh"
BR2_PACKAGE_BZIP2=y
BR2_PACKAGE_GZIP=y
BR2_PACKAGE_UNZIP=y
BR2_PACKAGE_ZIP=y
BR2_PACKAGE_GDB=y
BR2_PACKAGE_SPIDEV_TEST=y
BR2_PACKAGE_STRACE=y
BR2_PACKAGE_BINUTILS=y
BR2_PACKAGE_BINUTILS_TARGET=y
BR2_PACKAGE_DIFFUTILS=y
BR2_PACKAGE_FINDUTILS=y
BR2_PACKAGE_GAWK=y
BR2_PACKAGE_GIT=y
BR2_PACKAGE_GREP=y
BR2_PACKAGE_MAKE=y
BR2_PACKAGE_PATCH=y
BR2_PACKAGE_SED=y
BR2_PACKAGE_TREE=y
BR2_PACKAGE_MMC_UTILS=y
BR2_PACKAGE_SSHFS=y
BR2_PACKAGE_AVRDUDE=y
BR2_PACKAGE_DEVMEM2=y
BR2_PACKAGE_EDID_DECODE=y
BR2_PACKAGE_EEPROG=y
BR2_PACKAGE_I2C_TOOLS=y
BR2_PACKAGE_LIRC_TOOLS=y
BR2_PACKAGE_LM_SENSORS=y
BR2_PACKAGE_MINICOM=y
BR2_PACKAGE_NANOCOM=y
BR2_PACKAGE_OPENOCD=y
BR2_PACKAGE_OPENOCD_BCM2835=y
BR2_PACKAGE_OPENOCD_SYSFS=y
BR2_PACKAGE_PICOCOM=y
BR2_PACKAGE_READ_EDID=y
BR2_PACKAGE_SIGROK_CLI=y
BR2_PACKAGE_SPI_TOOLS=y
BR2_PACKAGE_STM32FLASH=y
BR2_PACKAGE_UBOOT_TOOLS=y
BR2_PACKAGE_UBOOT_TOOLS_MKIMAGE=y
BR2_PACKAGE_UBOOT_TOOLS_MKENVIMAGE=y
BR2_PACKAGE_USB_MODESWITCH=y
BR2_PACKAGE_USBUTILS=y
BR2_PACKAGE_PYTHON_READLINE=y
BR2_PACKAGE_PYTHON_SSL=y
BR2_PACKAGE_PYTHON_NUMPY=y
BR2_PACKAGE_PYTHON_RPI_GPIO=y
BR2_PACKAGE_PYTHON_SERIAL=y
BR2_PACKAGE_PYTHON_SMBUS_CFFI=y
BR2_PACKAGE_PYTHON_SPIDEV=y
BR2_PACKAGE_RUBY=y
BR2_PACKAGE_LIBIIO=y
BR2_PACKAGE_LIBIIO_TESTS=y
BR2_PACKAGE_LIBIIO_BINDINGS_PYTHON=y
BR2_PACKAGE_LIBSERIAL=y
BR2_PACKAGE_LIBSIGROKCXX=y
BR2_PACKAGE_WIRINGPI=y
BR2_PACKAGE_NSS_MDNS=y
BR2_PACKAGE_NCURSES_TARGET_PROGS=y
BR2_PACKAGE_AVAHI=y
BR2_PACKAGE_AVAHI_DAEMON=y
BR2_PACKAGE_AVAHI_LIBDNSSD_COMPATIBILITY=y
BR2_PACKAGE_DHCPCD=y
BR2_PACKAGE_NETCAT=y
BR2_PACKAGE_RSYNC=y
BR2_PACKAGE_SAMBA4=y
BR2_PACKAGE_SAMBA4_AD_DC=y
BR2_PACKAGE_SAMBA4_ADS=y
BR2_PACKAGE_WGET=y
BR2_PACKAGE_XINETD=y
BR2_PACKAGE_FILE=y
BR2_PACKAGE_SCREEN=y
BR2_PACKAGE_SUDO=y
BR2_PACKAGE_TIME=y
BR2_PACKAGE_TMUX=y
BR2_PACKAGE_WHICH=y
BR2_PACKAGE_FTOP=y
BR2_PACKAGE_IOTOP=y
BR2_PACKAGE_SYSTEMD_NETWORKD=y
BR2_PACKAGE_TAR=y
BR2_PACKAGE_LESS=y
BR2_PACKAGE_NANO=y
BR2_PACKAGE_VIM=y
BR2_PACKAGE_DOCSERVER=y
BR2_PACKAGE_GADGET_DOC=y
```

## package/usedbytes/docserver/Config.in
```kconfig
config BR2_PACKAGE_DOCSERVER
	bool "docserver"
	select BR2_PACKAGE_HOST_GO
	help
		Basic markdown web server

		https://github.com/usedbytes/docserver
```

## package/usedbytes/gadget-doc/Config.in
```kconfig
config BR2_PACKAGE_GADGET_DOC
	bool "gadget-doc"
	help
		Documentation for the Gadget project

		https://github.com/usedbytes/gadget-doc
```
